## conf/layer.conf
```bitbake
# We have a conf and classes directory, append to BBPATH
BBPATH .= ":${LAYERDIR}"

BBFILES += "${LAYERDIR}/recipes-*/*/*.bb ${LAYERDIR}/recipes-*/*/*.bbappend"

BSP-BASE-GFUTURES := '${@os.path.normpath("${LAYERDIR}/")}'
```

## conf/machine/bre2ze4k.conf
```bitbake
#@TYPE: Machine
#@NAME: wwio bre2ze4k
#@DESCRIPTION: Machine configuration for the bre2ze4k

SOC_FAMILY = "bcm7251s"
CHIPSET = "bcm7251s"

BRAND_OEM = "gfutures"
MACHINE_BRAND = "WWIO"
MACHINE_NAME = "BRE2ZE 4K"

KERNEL_FILE = "kernel.bin"
ROOTFS_FILE = "rootfs.tar.bz2"
MTD_BLACK = "mmcblk0"
MTD_BOOTFS = "mmcblk0p1"
MTD_KERNEL = "mmcblk0p2"
MTD_ROOTFS = "mmcblk0p3"

MACHINE_FEATURES += " ci dvb-c textlcd skins1080 qteglfs v3d-cortexa15 emmc v3d-nxpl HDMI AV_JACK"
OPENPLI_FEATURES += " qtplugins kodi openhbbtvbrowser"
DISTRO_FEATURES:remove = "x11 wayland directfb"

RCTYPE = "23"

require conf/machine/include/hd-cortex-a15.inc
```

## conf/machine/hd11.conf
```bitbake
#@TYPE: Machine
#@NAME: hd11
#@DESCRIPTION: Machine configuration for the hd11

SOC_FAMILY = "bcm73625"
CHIPSET = "bcm73625"

BRAND_OEM = "gfutures"
MACHINE_BRAND = "Mut@nt"
MACHINE_NAME = "HD11"

KERNEL_FILE = "kernel.bin"
ROOTFS_FILE = "rootfs.bin"
MTD_KERNEL = "mtd1"
MTD_ROOTFS = "mtd2"

MACHINE_FEATURES += " videoenhancement 7segment skins1080 HDMI AV_JACK"

MKUBIFS_ARGS = "-m 2048 -e 126976 -c 8192"
UBINIZE_ARGS = "-m 2048 -p 128KiB"

MACHINE_FEATURES += "h265"
DISTRO_FEATURES_remove = "x11 wayland directfb"

RCTYPE = "16"

require conf/machine/include/hd-mipsel.inc
```

## conf/machine/hd1100.conf
```bitbake
#@TYPE: Machine
#@NAME: hd1100
#@DESCRIPTION: Machine configuration for the hd1100

SOC_FAMILY = "bcm7358"
CHIPSET = "bcm7358"

BRAND_OEM = "gfutures"
MACHINE_BRAND = "Mut@nt"
MACHINE_NAME = "HD1100"

KERNEL_FILE = "kernel.bin"
ROOTFS_FILE = "rootfs.bin"
MTD_KERNEL = "mtd1"
MTD_ROOTFS = "mtd2"

MACHINE_FEATURES += " videoenhancement textlcd 7segment smallflash HDMI"
DISTRO_FEATURES:remove = "x11 wayland directfb"

MKUBIFS_ARGS = "-m 2048 -e 126976 -c 4096"
UBINIZE_ARGS = "-m 2048 -p 128KiB"

DEFAULTTUNE = "mips32el-nf"

RCTYPE = "16"

require conf/machine/include/hd-mipsel.inc
```

## conf/machine/hd1200.conf
```bitbake
#@TYPE: Machine
#@NAME: hd1200
#@DESCRIPTION: Machine configuration for the hd1200

SOC_FAMILY = "bcm7362"
CHIPSET = "bcm7362"

BRAND_OEM = "gfutures"
MACHINE_BRAND = "Mut@nt"
MACHINE_NAME = "HD1200"

KERNEL_FILE = "kernel.bin"
ROOTFS_FILE = "rootfs.bin"
MTD_KERNEL = "mtd1"
MTD_ROOTFS = "mtd2"

MACHINE_FEATURES += " videoenhancement textlcd 7segment skins1080 HDMI"
DISTRO_FEATURES:remove = "x11 wayland directfb"

MKUBIFS_ARGS = "-m 2048 -e 126976 -c 8192"
UBINIZE_ARGS = "-m 2048 -p 128KiB"

RCTYPE = "16"

require conf/machine/include/hd-mipsel.inc
```

## conf/machine/hd1265.conf
```bitbake
#@TYPE: Machine
#@NAME: hd1265
#@DESCRIPTION: Machine configuration for the hd1265

SOC_FAMILY = "bcm73625"
CHIPSET = "bcm73625"

BRAND_OEM = "gfutures"
MACHINE_BRAND = "Mut@nt"
MACHINE_NAME = "HD1265"

KERNEL_FILE = "kernel.bin"
ROOTFS_FILE = "rootfs.bin"
MTD_KERNEL = "mtd1"
MTD_ROOTFS = "mtd2"

MACHINE_FEATURES += " videoenhancement textlcd 7segment skins1080 h265 HDMI"

MKUBIFS_ARGS = "-m 2048 -e 126976 -c 8192"
UBINIZE_ARGS = "-m 2048 -p 128KiB"

DISTRO_FEATURES_remove = "x11 wayland directfb"

RCTYPE = "16"

require conf/machine/include/hd-mipsel.inc
```

## conf/machine/hd1500.conf
```bitbake
#@TYPE: Machine
#@NAME: hd1500
#@DESCRIPTION: Machine configuration for the hd1500

SOC_FAMILY = "bcm73625"
CHIPSET = "bcm73625"

BRAND_OEM = "gfutures"
MACHINE_BRAND = "Mut@nt"
MACHINE_NAME = "HD1500"

KERNEL_FILE = "kernel.bin"
ROOTFS_FILE = "rootfs.bin"
MTD_KERNEL = "mtd1"
MTD_ROOTFS = "mtd2"

MACHINE_FEATURES += " ci videoenhancement textlcd 7segment skins1080 h265 HDMI AV_JACK"

MKUBIFS_ARGS = "-m 2048 -e 126976 -c 8192"
UBINIZE_ARGS = "-m 2048 -p 128KiB"

DISTRO_FEATURES_remove = "x11 wayland directfb"

RCTYPE = "16"

require conf/machine/include/hd-mipsel.inc
```

## conf/machine/hd2400.conf
```bitbake
#@TYPE: Machine
#@NAME: hd2400
#@DESCRIPTION: Machine configuration for the hd2400

SOC_FAMILY = "bcm7425"
CHIPSET = "bcm7425"

BRAND_OEM = "skylake"
MACHINE_BRAND = "Mut@nt"
MACHINE_NAME = "HD2400"

KERNEL_FILE = "kernel.bin"
ROOTFS_FILE = "rootfs.bin"
MTD_KERNEL = "mtd1"
MTD_ROOTFS = "mtd2"

MACHINE_FEATURES += " dvb-c fanctrl bwlcd255 transcoding multitranscoding videoenhancement ci v3d-mipsel skins1080 SCART YUV RCA HDMI HDMI-IN-HD"
DISTRO_FEATURES:remove = "x11 wayland directfb"
OPENPLI_FEATURES += " kodi"

MKUBIFS_ARGS = "-m 2048 -e 126976 -c 8192"
UBINIZE_ARGS = "-m 2048 -p 128KiB"

RCTYPE = "19"

require conf/machine/include/hd-mipsel.inc
```

## conf/machine/hd500c.conf
```bitbake
#@TYPE: Machine
#@NAME: hd500c
#@DESCRIPTION: Machine configuration for the hd500c

SOC_FAMILY = "bcm7581"
CHIPSET = "bcm7581"

BRAND_OEM = "gfutures"
MACHINE_BRAND = "Mut@nt"
MACHINE_NAME = "HD500c"

KERNEL_FILE = "kernel.bin"
ROOTFS_FILE = "rootfs.bin"
MTD_KERNEL = "mtd1"
MTD_ROOTFS = "mtd2"

MACHINE_FEATURES += " videoenhancement textlcd 7segment dvb-c skins1080 smallflash HDMI RCA"
DISTRO_FEATURES_remove = "x11 wayland directfb"

MKUBIFS_ARGS = "-m 2048 -e 126976 -c 4096"
UBINIZE_ARGS = "-m 2048 -p 128KiB"

DEFAULTTUNE = "mips32el-nf"

RCTYPE = "16"

require conf/machine/include/hd-mipsel.inc
```

## conf/machine/hd51.conf
```bitbake
#@TYPE: Machine
#@NAME: hd51
#@DESCRIPTION: Machine configuration for the hd51

SOC_FAMILY = "bcm7251s"
CHIPSET = "bcm7251s"

BRAND_OEM = "gfutures"
MACHINE_BRAND = "Mut@nt"
MACHINE_NAME = "HD51"

KERNEL_FILE = "kernel.bin"
ROOTFS_FILE = "rootfs.tar.bz2"
MTD_BLACK = "mmcblk0"
MTD_BOOTFS = "mmcblk0p1"
MTD_KERNEL = "mmcblk0p2"
MTD_ROOTFS = "mmcblk0p3"

MACHINE_FEATURES += " ci dvb-c textlcd skins1080 qteglfs v3d-cortexa15 emmc v3d-nxpl HDMI AV_JACK"
OPENPLI_FEATURES += " qtplugins kodi openhbbtvbrowser"
DISTRO_FEATURES_remove = "x11 wayland directfb"

RCTYPE = "16"

require conf/machine/include/hd-cortex-a15.inc
```

## conf/machine/hd530c.conf
```bitbake
#@TYPE: Machine
#@NAME: hd530c
#@DESCRIPTION: Machine configuration for the hd530c

SOC_FAMILY = "bcm75839"
CHIPSET = "bcm75839"

BRAND_OEM = "gfutures"
MACHINE_BRAND = "Mut@nt"
MACHINE_NAME = "HD530c"

KERNEL_FILE = "kernel.bin"
ROOTFS_FILE = "rootfs.bin"
MTD_KERNEL = "mtd1"
MTD_ROOTFS = "mtd2"

MACHINE_FEATURES += " videoenhancement textlcd 7segment dvb-c skins1080 h265 HDMI AV_JACK"
DISTRO_FEATURES_remove = "x11 wayland directfb"

MKUBIFS_ARGS = "-m 2048 -e 126976 -c 8192"
UBINIZE_ARGS = "-m 2048 -p 128KiB"

RCTYPE = "16"

require conf/machine/include/hd-mipsel.inc
```

## conf/machine/hd60.conf
```bitbake
#@TYPE: Machine
#@NAME: hd60
#@DESCRIPTION: Machine configuration for the hd60

SOC_FAMILY = "hisi3798mv200"
CHIPSET = "Hi3798Mv200"
HICHIPSET = "3798mv200"

BRAND_OEM = "gfutures"
MACHINE_BRAND = "Mut@nt"
MACHINE_NAME = "HD60"

KERNEL_FILE = "uImage"
ROOTFS_FILE = "rootfs.tar.bz2"
MTD_BLACK  = "mmcblk0"
MTD_KERNEL = "mmcblk0p19"
MTD_ROOTFS = "mmcblk0p23"
MTD_BOOTFS = "mmcblk0p4"

MACHINE_FEATURES += "hdmicec textlcd 7segment hisil blindscan mali transcoding emmc skins1080 himedia no-subssupport gfwol fastboot mountboot HDMI AV_JACK"
OPENPLI_FEATURES += " qtplugins kodi openhbbtvbrowser"
DISTRO_FEATURES:remove = "x11 wayland directfb"

# TARGET_ARCH = "aarch64"
# DEFAULTTUNE = "aarch64"
TARGET_ARCH = "arm"
DEFAULTTUNE = "cortexa15hf-neon-vfpv4"

IMAGE_CLASSES += " hd-fastboot8gb_image"
IMAGE_FSTYPES += " hdfastboot8gb"
CMDLINE ?= "console=ttyAMA0,115200n8"

RCTYPE = "27"

require conf/machine/include/hd-hi3798mv.inc
```

## conf/machine/hd61.conf
```bitbake
#@TYPE: Machine
#@NAME: hd61
#@DESCRIPTION: Machine configuration for the hd61

SOC_FAMILY = "hisi3798mv200"
CHIPSET = "Hi3798Mv200"
HICHIPSET = "3798mv200"

BRAND_OEM = "gfutures"
MACHINE_BRAND = "Mut@nt"
MACHINE_NAME = "HD61"

KERNEL_FILE = "uImage"
ROOTFS_FILE = "rootfs.tar.bz2"
MTD_BLACK  = "mmcblk0"
MTD_KERNEL = "mmcblk0p19"
MTD_ROOTFS " "mmcblk0p23"
MTD_BOOTFS = "mmcblk0p4"

MACHINE_FEATURES += "hdmicec 7segment textlcd dvb-c ci hisil mali emmc skins1080 transcoding multitranscoding himedia no-subssupport blindscan-dvbs blindscan gfwol fastboot mountboot HDMI"
OPENPLI_FEATURES += " qtplugins kodi openhbbtvbrowser"
DISTRO_FEATURES_remove = "x11 wayland directfb"

# TARGET_ARCH = "aarch64"
# DEFAULTTUNE = "aarch64"
TARGET_ARCH = "arm"
DEFAULTTUNE = "cortexa15hf-neon-vfpv4"

IMAGE_CLASSES += " hd-fastboot8gb_image"
IMAGE_FSTYPES += " hdfastboot8gb"
CMDLINE ?= "console=ttyAMA0,115200n8"

RCTYPE = "27"

require conf/machine/include/hd-hi3798mv.inc
```

## conf/machine/include/hd-cortex-a15.inc
```bitbake
PREFERRED_VERSION_linux-hd = "4.10.12"

IMAGE_CLASSES += " hd-emmc_image_multiboot"
IMAGE_FSTYPES += " hdemmc tar"
IMAGE_ROOTFS_SIZE ?= "294912"

PREFERRED_PROVIDER_virtual/blindscan-dvbs ?= "hd-dvb-modules-${MACHINE}"
PREFERRED_PROVIDER_virtual/blindscan-dvbc ?= "hd-dvb-modules-${MACHINE}"

TARGET_ARCH = "arm"
DEFAULTTUNE = "cortexa15hf-neon-vfpv4"

require conf/machine/include/arm/armv7a/tune-cortexa15.inc
require conf/machine/include/hd.inc
```

## conf/machine/include/hd-hi3716mv.inc
```bitbake
MACHINE_KERNEL_PR = "r0"
KERNEL_MODULE_AUTOLOAD += "xfs"

# We know about rtc
MACHINE_FEATURES_BACKFILL_CONSIDERED = "rtc"

PREFERRED_VERSION_linux-hd = "4.4.35"

#Provider
PREFERRED_PROVIDER_virtual/kernel ?= "linux-hd"
PREFERRED_PROVIDER_virtual/blindscan-dvbs ?= "hd-dvb-modules-${MACHINE}"
PREFERRED_PROVIDER_virtual/blindscan-dvbc ?= "hd-dvb-modules-${MACHINE}"
PREFERRED_PROVIDER_virtual/gstreamer1.0-dvbmediasink ?= "gstreamer1.0-plugin-dvbmediasink"
PREFERRED_PROVIDER_virtual/enigma2-mediaservice ?= "enigma2-plugin-systemplugins-servicehisilicon"

# require conf/machine/include/arm/arch-armv8.inc
require conf/machine/include/tune-cortexa7.inc
require conf/machine/include/hd-essential.inc

# E2 OSD settings
EXTRA_OECONF:append:pn-enigma2 += " --with-alphablendingacceleration=always --with-blitaccelerationthreshold=250 --with-fillaccelerationthreshold=190000"

# Qt
PACKAGECONFIG_GL:pn-qtbase = " "
PACKAGECONFIG:append:pn-qtbase = " linuxfb"

# Gstreamer dvbmediasink
DVBMEDIASINK_CONFIG = "--with-h265 --with-vb8 --with-vb9 --with-wma --with-wmv --with-pcm --with-eac3 --with-amr --with-spark"

MACHINE_EXTRA_RRECOMMENDS = " \
	ffmpeg \
	gstreamer1.0-libav \
	ntfs-3g \
"

MACHINE_FEATURES += " alsa usbhost wlan 3dtv switchoff osdposition hdmicec"

IMAGEVERSION := "${DISTRO_NAME}-${DISTRO_VERSION}-${DATE}"
IMAGEVERSION[vardepsexclude] = "DATE"
IMAGEDIR ?= "hd"
IMGDEPLOYDIR ?= "${DEPLOY_DIR_IMAGE}"

IMAGE_CMD:ubi:append = " \
	mkdir -p ${IMGDEPLOYDIR}/${IMAGEDIR}/${MACHINE}; \
	cp ${IMGDEPLOYDIR}/${IMAGE_NAME}.ubi ${IMGDEPLOYDIR}/${IMAGEDIR}/${MACHINE}/rootfs.ubi; \
	cp ${DEPLOY_DIR_IMAGE}/uImage ${IMGDEPLOYDIR}/${IMAGEDIR}/${MACHINE}/uImage; \
	cp ${DEPLOY_DIR_IMAGE}/hd-partitions-${MACHINE}/update_bootargs_${MACHINE}.bin ${IMGDEPLOYDIR}/${IMAGEDIR}/update_bootargs_${MACHINE}.bin; \
	cp ${DEPLOY_DIR_IMAGE}/hd-partitions-${MACHINE}/${MACHINE}/fastboot.bin ${IMGDEPLOYDIR}/${IMAGEDIR}/${MACHINE}/fastboot.bin; \
	cp ${DEPLOY_DIR_IMAGE}/hd-partitions-${MACHINE}/${MACHINE}/bootargs.bin ${IMGDEPLOYDIR}/${IMAGEDIR}/${MACHINE}/bootargs.bin; \
	cp ${DEPLOY_DIR_IMAGE}/hd-partitions-${MACHINE}/${MACHINE}/pq_param.bin ${IMGDEPLOYDIR}/${IMAGEDIR}/${MACHINE}/pq_param.bin; \
	cp ${DEPLOY_DIR_IMAGE}/hd-partitions-${MACHINE}/${MACHINE}/baseparam.img ${IMGDEPLOYDIR}/${IMAGEDIR}/${MACHINE}/baseparam.img; \
	cp ${DEPLOY_DIR_IMAGE}/hd-partitions-${MACHINE}/${MACHINE}/logo.img ${IMGDEPLOYDIR}/${IMAGEDIR}/${MACHINE}/logo.img; \
	echo "${IMAGEVERSION}" > ${IMGDEPLOYDIR}/${IMAGEDIR}/imageversion; \
	cd ${IMGDEPLOYDIR}/${IMAGEDIR}; \
	zip -r ../${DISTRO_NAME}-${DISTRO_VERSION}-${MACHINE}_usb.zip *; \
	cd ..; \
	rm -Rf ${IMAGEDIR}; \
"
```

## conf/machine/vs1000.conf
```bitbake
#@TYPE: Machine
#@NAME: VS1000
#@DESCRIPTION: Machine configuration for the vs1000

SOC_FAMILY = "bcm73625"
CHIPSET = "bcm73625"

BRAND_OEM = "gfutures"
MACHINE_BRAND = "Vimastec"
MACHINE_NAME = "VS1000"

KERNEL_FILE = "kernel.bin"
ROOTFS_FILE = "rootfs.bin"
MTD_KERNEL = "mtd1"
MTD_ROOTFS = "mtd2"

MACHINE_FEATURES += " videoenhancement textlcd 7segment skins1080 smallflash h265 HDMI AV_JACK"
DISTRO_FEATURES_remove = "x11 wayland directfb"

MKUBIFS_ARGS = "-m 2048 -e 126976 -c 8192"
UBINIZE_ARGS = "-m 2048 -p 128KiB"

RCTYPE = "16"

require conf/machine/include/hd-mipsel.inc
```

## conf/machine/vs1500.conf
```bitbake
#@TYPE: Machine
#@NAME: vs1500
#@DESCRIPTION: Machine configuration for the vs1500

SOC_FAMILY = "bcm7251s"
CHIPSET = "bcm7251s"

BRAND_OEM = "gfutures"
MACHINE_BRAND = "Vimastec"
MACHINE_NAME = "VS1500"

KERNEL_FILE = "kernel.bin"
ROOTFS_FILE = "rootfs.tar.bz2"
MTD_BLACK = "mmcblk0"
MTD_BOOTFS = "mmcblk0p1"
MTD_KERNEL = "mmcblk0p2"
MTD_ROOTFS = "mmcblk0p3"

MACHINE_FEATURES += " ci dvb-c textlcd skins1080 qteglfs v3d-cortexa15 swap emmc v3d-nxpl HDMI"
OPENPLI_FEATURES += " qtplugins kodi openhbbtvbrowser"
DISTRO_FEATURES:remove = "x11 wayland directfb"

RCTYPE = "16"

require conf/machine/include/hd-cortex-a15.inc
```
